## ZMK Config/boards/shields/nicepillz/Kconfig.defconfig
```kconfig
# Copyright (c) 2020 The ZMK Contributors
# SPDX-License-Identifier: MIT

if SHIELD_NICEPILLZ

config ZMK_KEYBOARD_NAME
    default "Nice Pillz"

config SPI
    default y
    
endif
```

## ZMK Config/config/west.yml
```yaml
manifest:
  remotes:
    - name: zmkfirmware
      url-base: https://github.com/zmkfirmware
    - name: urob
      url-base: https://github.com/urob
  projects:
    - name: zmk
      remote: zmkfirmware
      revision: 8e065d55b916481ef06ce37cddedb84cf1d15d99 # main as of 2025-02-01, last known working bootloader
      import: app/west.yml
    - name: zmk-leader-key
      remote: urob
      revision: v0.3 # set to same as ZMK version above
    - name: zmk-helpers
      remote: urob
      revision: v0.3
  self:
    path: config
```
